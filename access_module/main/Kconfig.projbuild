## access_module/sdkconfig.defaults
```kconfig
# Portunus Access Module — Shared SDK configuration defaults
# Applied to all builds. Environment-specific overrides go in
# sdkconfig.defaults.dev or sdkconfig.defaults.prod.

# ── Target ─────────────────────────────────────────────────────────────────
CONFIG_IDF_TARGET="esp32s3"

# ── FreeRTOS ───────────────────────────────────────────────────────────────
# Use tick rate of 1000 Hz for 1ms tick resolution
CONFIG_FREERTOS_HZ=1000

# ── Serial flasher ────────────────────────────────────────────────────────
CONFIG_ESPTOOLPY_FLASHSIZE_4MB=y
CONFIG_ESPTOOLPY_FLASHMODE_DIO=y

# ── Partition table ───────────────────────────────────────────────────────
CONFIG_PARTITION_TABLE_SINGLE_APP=y

# ── Portunus defaults ─────────────────────────────────────────────────────
CONFIG_PORTUNUS_ENABLE_MFRC522=y
CONFIG_PORTUNUS_ENABLE_HEARTBEAT=y
CONFIG_PORTUNUS_HEARTBEAT_INTERVAL_MS=10000
CONFIG_PORTUNUS_MFRC522_POLL_INTERVAL_MS=250
CONFIG_PORTUNUS_EVENT_QUEUE_LENGTH=16
CONFIG_PORTUNUS_MAX_EVENT_SUBSCRIBERS=8
CONFIG_PORTUNUS_EVENT_QUEUE_TIMEOUT_MS=100
CONFIG_PORTUNUS_MFRC522_TASK_STACK_SIZE=4096

# ── SPI pin defaults (ESP32-S3 dev breadboard) ───────────────────────────
CONFIG_PORTUNUS_SPI_MOSI_PIN=11
CONFIG_PORTUNUS_SPI_MISO_PIN=13
CONFIG_PORTUNUS_SPI_SCLK_PIN=12
CONFIG_PORTUNUS_SPI_CS_PIN=10
CONFIG_PORTUNUS_MFRC522_RST_PIN=9

# ── WiFi / Network ───────────────────────────────────────────────────────
CONFIG_PORTUNUS_ENABLE_WIFI=y
CONFIG_PORTUNUS_MODULE_ID="door-001"
CONFIG_PORTUNUS_WIFI_SSID="portunus-dev"
CONFIG_PORTUNUS_WIFI_PASSWORD=""
CONFIG_PORTUNUS_WIFI_CONNECT_TIMEOUT_MS=15000
CONFIG_PORTUNUS_WIFI_RECONNECT_INTERVAL_MS=1000
CONFIG_PORTUNUS_SERVER_HOST="192.168.1.100"
CONFIG_PORTUNUS_SERVER_PORT=8080
CONFIG_PORTUNUS_SERVER_REQUEST_TIMEOUT_MS=5000

# ── mbedTLS / TLS ─────────────────────────────────────────────────────────

# Enable the mbedTLS stack (required for HTTPS and HMAC-SHA256).
CONFIG_MBEDTLS_TLS_CLIENT=y

# Enable the Mozilla CA certificate bundle so esp_crt_bundle_attach() is
# compiled in and server certificates can be validated without embedding a
# per-server cert in the firmware.
#
# esp_crt_bundle.h is provided by the "mbedtls" IDF component
# (components/mbedtls/esp_crt_bundle/include/esp_crt_bundle.h).
# Removing this line causes a linker error: undefined reference to
# `esp_crt_bundle_attach`.
CONFIG_MBEDTLS_CERTIFICATE_BUNDLE=y
CONFIG_MBEDTLS_CERTIFICATE_BUNDLE_DEFAULT_FULL=y

# Enable SHA-256 (required for HMAC-SHA256 signing via mbedtls/md.h).
CONFIG_MBEDTLS_SHA256_C=y

# ── esp_http_client / esp_tls ─────────────────────────────────────────────

# Keep HTTPS support compiled into esp_http_client.
CONFIG_ESP_HTTP_CLIENT_ENABLE_HTTPS=y

# These values are applied on top of ESP-IDF defaults whenever a fresh
# sdkconfig is generated (idf.py reconfigure / first build).  They ensure
# the security-critical Kconfig symbols are always present and correctly
# set, regardless of what idf.py menuconfig might do interactively.
#
# ── mbedTLS / TLS ─────────────────────────────────────────────────────────

# Enable the mbedTLS stack (required for HTTPS and HMAC-SHA256).
CONFIG_MBEDTLS_TLS_CLIENT=y

# Enable the Mozilla CA certificate bundle so esp_crt_bundle_attach() is
# compiled in and server certificates can be validated without embedding a
# per-server cert in the firmware.
#
# esp_crt_bundle.h is provided by the "mbedtls" IDF component
# (components/mbedtls/esp_crt_bundle/include/esp_crt_bundle.h).
# Removing this line causes a linker error: undefined reference to
# `esp_crt_bundle_attach`.
CONFIG_MBEDTLS_CERTIFICATE_BUNDLE=y
CONFIG_MBEDTLS_CERTIFICATE_BUNDLE_DEFAULT_FULL=y

# Enable SHA-256 (required for HMAC-SHA256 signing via mbedtls/md.h).
CONFIG_MBEDTLS_SHA256_C=y

# ── esp_http_client / esp_tls ─────────────────────────────────────────────

# Keep HTTPS support compiled into esp_http_client.
CONFIG_ESP_HTTP_CLIENT_ENABLE_HTTPS=y
```

## access_module/sdkconfig.defaults.ci
```kconfig
# CI: build-only config — no real server, no secrets, TLS cert check disabled.
# Deployment values (host, module ID, credentials) are not set here; the CI
# build uses PORTUNUS_ENV_DEV=y so the firmware compiles without NVS provisioning.
CONFIG_PORTUNUS_USE_TLS=y
CONFIG_PORTUNUS_TLS_SKIP_VERIFY=y
CONFIG_PORTUNUS_TLS_USE_CUSTOM_CA=n
CONFIG_ESP_TLS_INSECURE=y
CONFIG_ESP_TLS_SKIP_SERVER_CERT_VERIFY=y
CONFIG_PORTUNUS_HMAC_ENABLED=n
CONFIG_PORTUNUS_ENV_DEV=y
CONFIG_PORTUNUS_DEV_MODULE_ID="ci-module"
CONFIG_PORTUNUS_DEV_WIFI_SSID="ci-net"
CONFIG_PORTUNUS_DEV_WIFI_PSK=""
CONFIG_PORTUNUS_DEV_SERVER_HOST="ci.invalid"
CONFIG_PORTUNUS_DEV_GRPC_PORT=50051
```

## access_module/sdkconfig.defaults.dev
```kconfig
# DEV: relaxed security for rapid iteration; NVS fallback credentials used when
# NVS is not provisioned (PORTUNUS_ENV_DEV=y enables the Kconfig fallback path).
CONFIG_PORTUNUS_USE_TLS=y
CONFIG_PORTUNUS_TLS_SKIP_VERIFY=y
CONFIG_PORTUNUS_TLS_USE_CUSTOM_CA=y
CONFIG_ESP_TLS_INSECURE=y
CONFIG_ESP_TLS_SKIP_SERVER_CERT_VERIFY=y
CONFIG_PORTUNUS_HMAC_ENABLED=n
CONFIG_PORTUNUS_ENV_DEV=y
CONFIG_PORTUNUS_DEV_MODULE_ID="door-001-dev"
CONFIG_PORTUNUS_DEV_WIFI_SSID="portunus-dev"
CONFIG_PORTUNUS_DEV_WIFI_PSK=""
CONFIG_PORTUNUS_DEV_SERVER_HOST="10.0.0.59"
CONFIG_PORTUNUS_DEV_GRPC_PORT=50051
```

## access_module/sdkconfig.defaults.prod
```kconfig
# PROD: full security enabled; deployment values (host, module ID, credentials)
# come from NVS — provision with: task firmware:nvs:gen && task firmware:nvs:flash
CONFIG_PORTUNUS_USE_TLS=y
CONFIG_PORTUNUS_TLS_SKIP_VERIFY=n
CONFIG_PORTUNUS_TLS_USE_CUSTOM_CA=y
CONFIG_PORTUNUS_HMAC_ENABLED=y
```

## access_module/test/host_idf/main/Kconfig.projbuild
```kconfig
# Minimal Portunus symbol definitions for the Tier B host test build.
# Values mirror the production defaults in main/Kconfig.projbuild.
# Only the symbols actually referenced in FSM source under test are listed.

menu "Portunus Test Build Configuration"

    config PORTUNUS_MODULE_TYPE_ACCESS_POINT
        bool
        default y

    config PORTUNUS_UNLOCK_HOLD_MS
        int
        default 5000

    config PORTUNUS_FSM_POLL_INTERVAL_MS
        int
        default 50

    config PORTUNUS_MFRC522_POLL_INTERVAL_MS
        int
        default 250

    config PORTUNUS_CARD_REREAD_DELAY_MS
        int
        default 1000

    config PORTUNUS_HEARTBEAT_INTERVAL_MS
        int
        default 30000

    config PORTUNUS_EVENT_QUEUE_TIMEOUT_MS
        int
        default 10

    config PORTUNUS_EVENT_QUEUE_LENGTH
        int
        default 16

    config PORTUNUS_MAX_EVENT_SUBSCRIBERS
        int
        default 16

    config PORTUNUS_PROVISION_TIMEOUT_MS
        int
        default 30000

    config PORTUNUS_ARM_TIMEOUT_MS
        int
        default 60000

    config PORTUNUS_IDLE_TIMEOUT_MS
        int
        default 300000

    config PORTUNUS_RESULT_DISPLAY_MS
        int
        default 3000

endmenu
```

## access_module/test/host_idf/sdkconfig.defaults
```kconfig
# Tier B host test sdkconfig defaults
# Target: linux (POSIX FreeRTOS simulator)
CONFIG_IDF_TARGET="linux"

# Enable the ACCESS_POINT FSM variant for behavioral tests
CONFIG_PORTUNUS_MODULE_TYPE_ACCESS_POINT=y

# WiFi disabled — tests run offline; has_network=false unless set explicitly
# CONFIG_PORTUNUS_ENABLE_WIFI is not set

# Timing constants used by the FSM (match production defaults)
CONFIG_PORTUNUS_UNLOCK_HOLD_MS=5000
CONFIG_PORTUNUS_FSM_POLL_INTERVAL_MS=50
CONFIG_PORTUNUS_MFRC522_POLL_INTERVAL_MS=250
CONFIG_PORTUNUS_CARD_REREAD_DELAY_MS=1000
CONFIG_PORTUNUS_HEARTBEAT_INTERVAL_MS=30000
CONFIG_PORTUNUS_EVENT_QUEUE_TIMEOUT_MS=10
CONFIG_PORTUNUS_EVENT_QUEUE_LENGTH=16
CONFIG_PORTUNUS_MAX_EVENT_SUBSCRIBERS=16
CONFIG_PORTUNUS_PROVISION_TIMEOUT_MS=30000
CONFIG_PORTUNUS_ARM_TIMEOUT_MS=60000
CONFIG_PORTUNUS_IDLE_TIMEOUT_MS=300000
CONFIG_PORTUNUS_RESULT_DISPLAY_MS=3000
```

## door_access_module/sdkconfig.defaults
```kconfig
# Target is set via: idf.py set-target esp32s3

CONFIG_PORTUNUS_FW_VERSION="0.1.0"
CONFIG_PORTUNUS_MODULE_ID="door-001"

CONFIG_PORTUNUS_SERVER_BASE_URL="http://192.168.1.50:8080"
CONFIG_PORTUNUS_HEARTBEAT_INTERVAL_MS=5000

# WiFi (MVP: compile-time config; later: provisioning -> NVS)
CONFIG_PORTUNUS_WIFI_SSID="YOUR_WIFI"
CONFIG_PORTUNUS_WIFI_PASSWORD="YOUR_PASS"

# Required hardware defaults
CONFIG_PORTUNUS_STRIKE_GPIO=6
CONFIG_PORTUNUS_STRIKE_ACTIVE_HIGH=y

# Optional hardware (off by default)
# CONFIG_PORTUNUS_ENABLE_REED_SWITCH is not set
# CONFIG_PORTUNUS_ENABLE_STATUS_LED is not set
CONFIG_PORTUNUS_REED_GPIO=7
CONFIG_PORTUNUS_REED_ACTIVE_LOW=y
CONFIG_PORTUNUS_STATUS_LED_GPIO=8
CONFIG_PORTUNUS_STATUS_LED_ACTIVE_HIGH=y
```

## door_accesss_module/components/portunus_config/Kconfig
```kconfig
menu "Portunus Door Access Module"

config PORTUNUS_FW_VERSION
    string "Firmware version string"
    default "0.1.0"

config PORTUNUS_MODULE_ID
    string "Module ID (later moved to provisioning/NVS)"
    default "door-001"

config PORTUNUS_SERVER_BASE_URL
    string "Server base URL (http(s)://host:port)"
    default "http://192.168.1.50:8080"

config PORTUNUS_HEARTBEAT_INTERVAL_MS
    int "Heartbeat interval (ms)"
    default 5000

menu "WiFi (MVP)"
config PORTUNUS_WIFI_SSID
    string "WiFi SSID"
    default "YOUR_WIFI"

config PORTUNUS_WIFI_PASSWORD
    string "WiFi Password"
    default "YOUR_PASS"
endmenu

menu "Required hardware"
config PORTUNUS_STRIKE_GPIO
    int "Door strike GPIO"
    default 6

config PORTUNUS_STRIKE_ACTIVE_HIGH
    bool "Strike active high"
    default y
endmenu

menu "Optional hardware"

config PORTUNUS_ENABLE_REED_SWITCH
    bool "Enable reed switch door sensor"
    default n

config PORTUNUS_REED_GPIO
    int "Reed switch GPIO"
    default 7
    depends on PORTUNUS_ENABLE_REED_SWITCH

config PORTUNUS_REED_ACTIVE_LOW
    bool "Reed active low (pull-up)"
    default y
    depends on PORTUNUS_ENABLE_REED_SWITCH

config PORTUNUS_ENABLE_STATUS_LED
    bool "Enable status LED"
    default n

config PORTUNUS_STATUS_LED_GPIO
    int "Status LED GPIO"
    default 8
    depends on PORTUNUS_ENABLE_STATUS_LED

config PORTUNUS_STATUS_LED_ACTIVE_HIGH
    bool "Status LED active high"
    default y
    depends on PORTUNUS_ENABLE_STATUS_LED

endmenu

endmenu
```

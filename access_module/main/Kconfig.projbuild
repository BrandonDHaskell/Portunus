## access_module/main/Kconfig.projbuild
```kconfig
menu "Portunus Configuration"

    menu "Feature Toggles"
        config PORTUNUS_ENABLE_MFRC522
            bool "Enable MFRC522 RFID reader"
            default y

        config PORTUNUS_ENABLE_HEARTBEAT
            bool "Enable heartbeat service"
            default y

        config PORTUNUS_ENABLE_WIFI
            bool "Enable WiFi connectivity"
            default y
            help
                Enable the WiFi station manager. When disabled the module
                runs in offline mode (events are logged locally only).

        config PORTUNUS_ENABLE_DOOR_STRIKE
            bool "Enable door strike output"
            default y
            help
                Enable the door strike GPIO driver. Disable for bench
                testing without strike hardware connected.

        config PORTUNUS_ENABLE_REED_SWITCH
            bool "Enable reed switch input"
            default y
            help
                Enable the reed switch GPIO driver for door state
                monitoring. Disable for bench testing without a reed
                switch connected.

        config PORTUNUS_ENABLE_LED
            bool "Enable status LED"
            default y
            help
                Enable the status LED for visual feedback. Disable for
                headless or bench-test configurations.
    endmenu

    menu "Security Configuration"
        depends on PORTUNUS_ENABLE_WIFI

        config PORTUNUS_USE_TLS
            bool "Enable TLS (HTTPS) for server communication"
            default y
            help
                Encrypt all communication with the Portunus server using TLS.
                When enabled, URLs use https:// and the ESP-IDF mbedTLS stack
                validates the server certificate against the Mozilla CA bundle
                embedded in the firmware.  Disable only for isolated lab
                networks where a CA-signed cert is not available.

        config PORTUNUS_TLS_SERVER_PORT
            int "HTTPS server port"
            default 8443
            range 1 65535
            depends on PORTUNUS_USE_TLS
            help
                TCP port the Portunus server listens on for TLS connections.
                The plain HTTP port (PORTUNUS_SERVER_PORT) is used when TLS
                is disabled.

        config PORTUNUS_TLS_SKIP_VERIFY
            bool "Skip TLS certificate verification (INSECURE – dev only)"
            default n
            depends on PORTUNUS_USE_TLS
            help
                Bypass server certificate validation.  Allows self-signed or
                expired certificates but removes all transport security
                guarantees.  NEVER enable in production.

        config PORTUNUS_HMAC_ENABLED
            bool "Enable HMAC-SHA256 request signing"
            default y
            depends on PORTUNUS_ENABLE_WIFI
            help
                Sign every outgoing request body with a pre-shared HMAC-SHA256
                key.  The server verifies the X-Portunus-Sig header before
                processing any message, ensuring only enrolled modules can
                submit requests.

        config PORTUNUS_HMAC_SECRET
            string "HMAC shared secret (pre-shared key)"
            default ""
            depends on PORTUNUS_HMAC_ENABLED
            help
                The shared secret used to compute HMAC-SHA256 signatures.
                Must match the PORTUNUS_HMAC_SECRET environment variable on
                the server.  Generate with: openssl rand -hex 32

                WARNING: stored in flash.  Protect your build artifacts.

    endmenu

    menu "Network Configuration"
        depends on PORTUNUS_ENABLE_WIFI
        
        config PORTUNUS_MODULE_ID
            string "Module identifier"
            default "door-001"
            help
                Unique name for this access module, sent in every heartbeat
                and access request so the server can identify the device.
                Maximum 32 characters (PORTUNUS_MAX_NAME_LEN).

        config PORTUNUS_WIFI_SSID
            string "WiFi SSID"
            default "portunus-dev"
            help
                SSID of the wireless network the module connects to.

        config PORTUNUS_WIFI_PASSWORD
            string "WiFi password"
            default ""
            help
                WPA2 passphrase. Leave empty for open networks.

        config PORTUNUS_WIFI_CONNECT_TIMEOUT_MS
            int "WiFi connection timeout (milliseconds)"
            default 15000
            range 5000 60000
            help
                Maximum time wifi_mgr_start() blocks waiting for an IP
                address. The manager continues reconnecting in the
                background after this timeout expires.

        config PORTUNUS_WIFI_RECONNECT_INTERVAL_MS
            int "WiFi reconnect base interval (milliseconds)"
            default 1000
            range 500 10000
            help
                Base delay before the first reconnection attempt after a
                disconnect. The interval doubles on each failure up to a
                60-second ceiling, and resets on a successful connection.

        config PORTUNUS_SERVER_HOST
            string "Portunus server host"
            default "192.168.1.100"
            help
                Hostname or IP address of the Portunus server.

        config PORTUNUS_SERVER_PORT
            int "Portunus server port"
            default 8080
            range 1 65535
            help
                TCP port the Portunus server listens on.

        config PORTUNUS_SERVER_REQUEST_TIMEOUT_MS
            int "HTTP request timeout (milliseconds)"
            default 5000
            range 1000 30000
            help
                Maximum time to wait for a response from the server on
                heartbeat and access-request HTTP calls.
    endmenu

    menu "Task Configuration"
        config PORTUNUS_MFRC522_TASK_STACK_SIZE
            int "MFRC522 polling task stack size"
            default 4096
            range 2048 8192
    endmenu

    menu "SPI Pin Assignments (MFRC522)"
        config PORTUNUS_SPI_MOSI_PIN
            int "SPI MOSI GPIO pin"
            default 37
            help
                GPIO pin connected to the MFRC522 MOSI line.

        config PORTUNUS_SPI_MISO_PIN
            int "SPI MISO GPIO pin"
            default 38
            help
                GPIO pin connected to the MFRC522 MISO line.

        config PORTUNUS_SPI_SCLK_PIN
            int "SPI SCLK GPIO pin"
            default 36
            help
                GPIO pin connected to the MFRC522 SCLK line.

        config PORTUNUS_SPI_CS_PIN
            int "SPI CS GPIO pin"
            default 35
            help
                GPIO pin connected to the MFRC522 SDA/CS line.

        config PORTUNUS_MFRC522_RST_PIN
            int "MFRC522 RST GPIO pin"
            default 4
            help
                GPIO pin connected to the MFRC522 RST line.
                Set to -1 to leave RST unconnected (not recommended).
    endmenu

    menu "Door Hardware Pin Assignments"
        config PORTUNUS_DOOR_STRIKE_PIN
            int "Door strike GPIO pin"
            default 5
            depends on PORTUNUS_ENABLE_DOOR_STRIKE
            help
                GPIO pin connected to the door strike relay or MOSFET gate.

        config PORTUNUS_DOOR_STRIKE_ACTIVE_LOW
            bool "Door strike active-low logic"
            default n
            depends on PORTUNUS_ENABLE_DOOR_STRIKE
            help
                Enable if the strike relay/MOSFET is active-low (i.e.,
                pulling the GPIO LOW energizes the strike). Default is
                active-high (GPIO HIGH = strike energized = door unlocked).

        config PORTUNUS_REED_SWITCH_PIN
            int "Reed switch GPIO pin"
            default 6
            depends on PORTUNUS_ENABLE_REED_SWITCH
            help
                GPIO pin connected to the reed switch. An internal pull-up
                is enabled; the switch should short the pin to GND when
                the door is closed (normally-open configuration).

        config PORTUNUS_REED_SWITCH_NC
            bool "Reed switch is normally-closed"
            default n
            depends on PORTUNUS_ENABLE_REED_SWITCH
            help
                Enable if the reed switch is normally-closed (circuit
                closed when door is closed). Default is normally-open
                (circuit open when door is open, closed when magnet
                aligns with sensor = door shut).

        config PORTUNUS_LED_PIN
            int "Status LED GPIO pin"
            default 7
            depends on PORTUNUS_ENABLE_LED
            help
                GPIO pin connected to the status LED (active-high).
    endmenu

    menu "Door Configuration"
        config PORTUNUS_UNLOCK_HOLD_MS
            int "Default unlock hold duration (milliseconds)"
            default 5000
            range 1000 30000
            help
                How long the door strike stays energized after an
                access-granted decision. The FSM re-locks when this
                timer expires OR when the door opens and closes,
                whichever comes first.

        config PORTUNUS_REED_SWITCH_DEBOUNCE_MS
            int "Reed switch debounce time (milliseconds)"
            default 50
            range 20 200
            depends on PORTUNUS_ENABLE_REED_SWITCH
            help
                Minimum time the reed switch signal must be stable
                before a state change is accepted. Prevents spurious
                transitions from vibration or magnetic interference.

        config PORTUNUS_FSM_POLL_INTERVAL_MS
            int "FSM reed switch poll interval (milliseconds)"
            default 100
            range 50 500
            help
                How frequently the FSM polls the reed switch and
                checks for unlock timer expiry. Also serves as the
                event wait timeout in the FSM main loop.
    endmenu

    menu "Timing Configuration"
        config PORTUNUS_HEARTBEAT_INTERVAL_MS
            int "Heartbeat interval (milliseconds)"
            default 10000
            range 1000 60000
            help
                Interval between heartbeat events. 10 seconds is a
                reasonable default for development.

        config PORTUNUS_MFRC522_POLL_INTERVAL_MS
            int "MFRC522 card poll interval (milliseconds)"
            default 250
            range 50 2000
            help
                How frequently the MFRC522 driver checks for a card
                in the reader field. Lower values are more responsive
                but increase SPI bus traffic.

        config PORTUNUS_CARD_REREAD_DELAY_MS
            int "Card re-read delay after successful read (milliseconds)"
            default 1000
            range 200 5000
            help
                Extra delay after a successful card read to prevent 
                the same card from being re-read while the user holds 
                it against the reader. Applied on top of the normal 
                poll interval.

        config PORTUNUS_EVENT_QUEUE_TIMEOUT_MS
            int "Event bus queue send/receive timeout (milliseconds)"
            default 100
            range 10 5000
            help
                Maximum time to block when sending to or receiving from
                the event bus queue.
    endmenu

    menu "Event Bus Configuration"
        config PORTUNUS_EVENT_QUEUE_LENGTH
            int "Event bus queue depth"
            default 16
            range 4 64
            help
                Number of events the dispatcher queue can hold. A deeper
                queue absorbs bursts but consumes more RAM.

        config PORTUNUS_MAX_EVENT_SUBSCRIBERS
            int "Maximum event subscribers"
            default 8
            range 2 32
            help
                Maximum number of callback subscribers the event bus
                supports. Increase if more components need to listen.
    endmenu

endmenu
```
